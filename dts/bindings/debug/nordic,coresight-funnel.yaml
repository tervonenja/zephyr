## dts/bindings/debug/nordic,coresight-funnel.yaml
```yaml
# Copyright (c) 2026 Nordic Semiconductor ASA
# SPDX-License-Identifier: Apache-2.0

description: Nordic Coresight Funnel Configuration

compatible: "nordic,coresight-funnel"

include: [base.yaml]

properties:
  reg:
    required: true

  ctrl-reg:
    required: false
    type: int
    description: |
      Control register value written to ATBFUNNEL CTRLREG to select enabled input ports.
```

## dts/bindings/debug/nordic,coresight-nrf.yaml
```yaml
# Copyright (c) 2025 Nordic Semiconductor ASA
# SPDX-License-Identifier: Apache-2.0

description: Nordic Coresight Subsystem (Trace Port Interface Unit)

compatible: "nordic,coresight-nrf"

include: [base.yaml, pinctrl-device.yaml, nordic-clockpin.yaml]

properties:
  reg:
    required: true

  clocks:
    required: true
    description: Clock source for the CoreSight timestamp generator (e.g. hsfll200).

  mode:
    required: true
    type: string
    enum:
      - "unconfigured"
      - "stm-tpiu"
      - "stm-etr"
    description: >
      Specifies which mode to configure the Coresight subsystem in.
```

## dts/bindings/debug/nordic,coresight-replicator.yaml
```yaml
# Copyright (c) 2026 Nordic Semiconductor ASA
# SPDX-License-Identifier: Apache-2.0

description: Nordic Coresight Replicator Configuration

compatible: "nordic,coresight-replicator"

include: [base.yaml]

properties:
  reg:
    required: true

child-binding:
  description: "ID filters of the replicator"
  properties:
    "#address-cells":
      type: int
      const: 1
    "#size-cells":
      type: int
      const: 0
    reg:
      type: int
      required: true
    filter:
      type: int
      required: true
```
